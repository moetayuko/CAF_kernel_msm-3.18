/*
 * Copyright (c) 2015-2016, The Linux Foundation. All rights reserved.
 *
 * This program is free software; you can redistribute it and/or modify
 * it under the terms of the GNU General Public License version 2 and
 * only version 2 as published by the Free Software Foundation.
 *
 * This program is distributed in the hope that it will be useful,
 * but WITHOUT ANY WARRANTY; without even the implied warranty of
 * MERCHANTABILITY or FITNESS FOR A PARTICULAR PURPOSE.  See the
 * GNU General Public License for more details.
 */

/dts-v1/;

#include "apq8053.dtsi"
#include "apq8053-dragon.dtsi"

/ {
	model = "Intrinsyc Technologies, Corp. APQ8053 Open-Q 626 DragonBoard rev.1";
	compatible = "qcom,apq8053-dragon", "qcom,apq8053", "qcom,dragon", "itc,rev1";
	qcom,board-id= <10 0x1>;
};

&blsp2_uart1 {
        status = "ok";
};

&i2c_2 {
       /delete-property/ adv7533@39;
       status = "ok";
};
