## drivers/input/misc/vl6180/Kconfig
```kconfig
config STMVL6180
	tristate "STM VL6180 Proximity support"
	depends on I2C=y
	default y
	help
	  Say Y here if you want to use STMicroelectronics's proximity sensor
	  through I2C interface.

	  To compile this driver as a module, choose M here: the
	  module will be called stmvl6180.
```

## drivers/platform/Kconfig
```kconfig
# drivers/platform/Kconfig

if X86
source "drivers/platform/x86/Kconfig"
endif
if MIPS
source "drivers/platform/mips/Kconfig"
endif

source "drivers/platform/goldfish/Kconfig"

if ARM
source "drivers/platform/arm/Kconfig"
endif

source "drivers/platform/chrome/Kconfig"
```

## drivers/power/Kconfig
```kconfig
# Fuel Gauge

config FUELGAUGE_STC3117
	tristate "STC3117 fuel gauge driver"
	default n
	depends on I2C
	help
	 Say Y to include support
	 for STC3117 fuel gauge driver for batteries.
	 This driver source code implemented
	 all functions for STC3117 fuel gauge.
```

## drivers/serio/Kconfig
```kconfig
#
# serio core configuration
#
menuconfig SERIO
	tristate "Serial I/O bus support"
	default y
	help
	  Say Yes here if you have any serial attached devices that use serial
	  I/O to communicate with the system. This includes the
			* standard AT keyboard and PS/2 mouse *
	  as well as serial mice, Sun keyboards, some joysticks, 6dof devices,
	  UART-based Bluetooth/WiFi/NFC devices and more.

	  If unsure, say Y.

	  To compile this driver as a module, choose M here: the
	  module will be called serio.
```

## drivers/soc/fsl/Kconfig
```kconfig
#
# Freescale SOC drivers
#

source "drivers/soc/fsl/qe/Kconfig"

config FSL_GUTS
	bool
```

## drivers/staging/typec/Kconfig
```kconfig
menu "USB Power Delivery and Type-C drivers"

config TYPEC_TCPM
	tristate "USB Type-C Port Controller Manager"
	depends on USB
	select TYPEC
	help
	  The Type-C Port Controller Manager provides a USB PD and USB Type-C
	  state machine for use with Type-C Port Controllers.

if TYPEC_TCPM

config TYPEC_TCPCI
	tristate "Type-C Port Controller Interface driver"
	depends on I2C
	select REGMAP_I2C
	help
	  Type-C Port Controller driver for TCPCI-compliant controller.

config TYPEC_CROS_EC
	tristate "Chrome EC Type-C Port Controller driver"
	depends on MFD_CROS_EC
	help
	  Chrome EC Type-C Port Controller driver.

source "drivers/staging/typec/fusb302/Kconfig"

endif

endmenu
```
