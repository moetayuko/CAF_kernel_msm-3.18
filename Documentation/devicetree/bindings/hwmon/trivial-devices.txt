## Documentation/devicetree/bindings/i2c/trivial-devices.txt
```
This is a list of trivial i2c devices that have simple device tree
bindings, consisting only of a compatible field, an address and
possibly an interrupt line.

If a device needs more specific bindings, such as properties to
describe some aspect of it, there needs to be a specific binding
document for it just like any other devices.


Compatible		Vendor / Chip
==========		=============


silabs,si7020		Relative Humidity and Temperature Sensors


ams,iaq-core		AMS iAQ-Core VOC Sensor
fsl,mag3110		MAG3110: Xtrinsic High Accuracy, 3D Magnetometer
fsl,mpl3115		MPL3115: Absolute Digital Pressure Sensor
fsl,mpr121		MPR121: Proximity Capacitive Touch Sensor Controller
pulsedlight,lidar-lite-v2	Pulsedlight LIDAR range-finding sensor


maxim,ds1050		5 Bit Programmable, Pulse-Width Modulator
microchip,tc654		PWM Fan Speed Controller With Fan Fault Detection
microchip,tc655		PWM Fan Speed Controller With Fan Fault Detection

maxim,max1237		Low-Power, 4-/12-Channel, 2-Wire Serial, 12-Bit ADCs
ti,ads7828		8-Channels, 12-bit ADC
ti,ads7830		8-Channels, 8-bit ADC


cirrus,cs42l51		Cirrus Logic CS42L51 audio codec

dallas,ds1682		Total-Elapsed-Time Recorder with Alarm
dallas,ds4510		CPU Supervisor with Nonvolatile Memory and Programmable I/O


nxp,pca9556		Octal SMBus and I2C registered interface
nxp,pca9557		8-bit I2C-bus and SMBus I/O port with reset

oki,ml86v7667		OKI ML86V7667 video decoder
ovti,ov5642		OV5642: Color CMOS QSXGA (5-megapixel) Image Sensor with OmniBSI and Embedded TrueFocus
plx,pex8648		48-Lane, 12-Port PCI Express Gen 2 (5.0 GT/s) Switch

samsung,24ad0xd1	S524AD0XF1 (128K/256K-bit Serial EEPROM for Low Power)

sgx,vz89x		SGX Sensortech VZ89X Sensors
skyworks,sky81452	Skyworks SKY81452: Six-Channel White LED Driver with Touch Panel Bias Supply
ti,tsc2003		I2C Touch-Screen Controller
```

## Documentation/devicetree/bindings/input/misc/kionix_accel.txt
```
Kionix kxtj2-1029 3-axis accelerometer sensor driver.

Required properties:

 - compatible		: Should be "kionix,kxtj2-1029".
 - reg			: i2c slave address of the device.
 - interrupt-parent	: Parent of interrupt.
 - interrupts		: Accelerometer interrupts to indicate new data ready or events.
 - vdd-supply		: Analog power supply needed to power device.
 - vio-supply		: Digital IO power supply needed for IO and I2C.
 - kionix,min-interval		: Minimum data polling interval in millisecond.
 - kionix,poll-interval		: Initial data polling interval in millisecond.
 - kionix,accel-direction	: The direction of the 3-axis accelerometer sensor chip. There are 8
	patterns of direction described as below：
				1: 1st pin is right down
				2: 1st pin is left down
				3: 1st pin is left top
				4: 1st pin is right top
				5: 1st pin is left down (from top view)
				6: 1st pin is left top (from top view)
				7: 1st pin is right top (from top view)
				8: 1st pin is right down (from top view)
 - kionix,accel-irq-use-drdy	: Choose whether to use DRDY hardware interrupt
	mode to trigger a data report event or to use the software polling mode.
	e.g. Giving "0" to this property means using the software polling mode.

 - kionix,accel-res		: Select output data resolution. We can select "12", "8" or "6". And
	the sensor will be configured to output 12/8/6 bits of data. The default value is "12".

 - kionix,accel-g-range		: Select initial range of measurement. It defines the initial
	configuration of the maximum measurement range of the sensor. Where 0 is 2G, 1 is 4G,
	2 is 6G, 3 is 8G, 2G will be used for any other values.

Example:
	i2c@78b5000 {
		kionix@e {
			compatible = "kionix,kxtj2-1029";
			reg = <0x0e>;
			interrupt-parent = <&msm_gpio>;
			interrupts = <94 0x2002>;
			vdd-supply = <&pm8916_l17>;
			vio-supply = <&pm8916_l6>;
			kionix,min-interval = <5>;
			kionix,poll-interval = <100>;
			kionix,accel-direction = <1>;
			kionix,accel-irq-use-drdy = <0>;
			kionix,accel-res = <12>;
			kionix,accel-g-range = <2>;
		};
	};
```

## Documentation/devicetree/bindings/input/misc/ltr559.txt
```
Liteon ltr559 light and proximity sensor

Required properties:

 - compatible		: Should be "liteon,ltr559".
 - reg			: i2c slave address of the device.
 - pinctrl-names	: The pinctrl configuration names of this sensor driver. Should be
	"default" and "sleep".
 - pinctrl-0		: Should specify pin control groups used for this controller.
 - pinctrl-1		: Should specify pin control groups used for this controller.
 - interrupt-parent	: Parent of interrupt.
 - interrupts		: light and proximity sample interrupt to indicate new data ready.
 - vdd-supply		: Power supply needed to power up the device.
 - vio-supply		: IO power supply needed for IO and I2C.
 - liteon,intr		: The gpio pin for the interrupt.
 - liteon,highthr	: The threshold adc value for proximity sensor to trigger close interrupt.
 - liteon,lowthr	: The threshold adc value for proximity sensor to trigger away interrupt.

Example:
	i2c@78b5000 {
		liteon@23 {
			compatible = "liteon,ltr559";
			reg = <0x23>;
			pinctrl-names = "default","sleep";
			pinctrl-0 = <&ltr559_default>;
			pinctrl-1 = <&ltr559_sleep>;
			interrupt-parent = <&msm_gpio>;
			interrupts = <94 0x2002>;
			vdd-supply = <&pm8916_l17>;
			vio-supply = <&pm8916_l6>;
			liteon,intr = <&msm_gpio 94 0x2002>;
			liteon,highthr = <800>;
			liteon,lowthr = <300>;
		};
	};
```

## Documentation/devicetree/bindings/input/touchscreen/gt9xx/gt9xx.txt
```
Goodix GT9xx series touch controller

Required properties:

 - compatible		: Should be "goodix,gt9xx"
 - reg			: I2C slave address of the device.
 - interrupt-parent	: Parent of interrupt.
 - interrupts		: Configuration of touch panel controller interrupt
				GPIO.
 - goodix,product-id	: Product identification of the controller.
 - interrupt-gpios	: Interrupt gpio which is to provide interrupts to
				host, same as "interrupts" node.
 - reset-gpios		: Reset gpio to control the reset of chip.
 - goodix,display-coords	: Display coordinates in pixels. It is a four
				tuple consisting of min x, min y, max x and
				max y values.

Optional properties:

 - vdd-supply		: Power supply needed to power up the device, when use
				external regulator, do not add this property.
 - vcc-i2c-supply	: Power source required to power up i2c bus.
				GT9xx series can provide 1.8V from internal
				LDO, add this properties base on hardware
				design.
 - goodix,panel-coords	: Panel coordinates for the chip in pixels.
				It is a four tuple consisting of min x,
				min y, max x and max y values.
 - goodix,i2c-pull-up	: To specify pull up is required.
 - goodix,soft_rst_dly	: The delay time needed on soft reset for the IC.
 - goodix,num_max_touches	: The maximum number of touches that can be
					supported.
 - goodix,no-force-update	: To specify force update is allowed.
 - goodix,enable-power-off	: Power off touchscreen during suspend.
 - goodix,button-map	: Button map of key codes. The number of key codes
				depend on panel.
 - goodix,name		: The IC name.
 - goodix,fw-name	: Touch screen controller firmware file name.
 - goodix,fw-vkey-support	: To specify firmware virtual key is supported.

Example:
	i2c@78b7000 {
		status = "ok";
		goodix@5d {
			compatible = "goodix,gt9xx";
			reg = <0x5d>;
			interrupt-parent = <&tlmm>;
			interrupts = <65 0x2008>;
			reset-gpios = <&tlmm 64 0x00>;
			interrupt-gpios = <&tlmm 65 0x2008>;
			vdd-supply = <&pm8917_l10>;
			vcc-i2c-supply = <&pm8917_l5>;
			goodix,button-map = <158 139 172>;
			goodix,panel-coords = <0 0 1080 2098>;
			goodix,display-coords = <0 0 1080 1920>;
			goodix,product-id = "5668";
			goodix,num_max_touches = <5>;
			goodix,soft_rst_dly = <20>;
			goodix,name = "GT5668";
			goodix,fw_name = "gtp_fw.bin";
			goodix,fw-vkey-support;
			goodix,i2c-pull-up;
			goodix,no-force-update;
			goodix,enable-power-off;
		};
	};
```

## Documentation/devicetree/bindings/jcore/cpus.txt
```
===================
J-Core cpu bindings
===================

The J-Core processors are open source CPU cores that can be built as FPGA
soft cores or ASICs. The device tree is also responsible for describing the
cache controls and, for SMP configurations, all details of the SMP method.

The current version of this document covers only uniprocessor configurations.


---------------------
Top-level "cpus" node
---------------------

Required properties:

- #address-cells: Must be 1.

- #size-cells: Must be 0.


--------------------
Individual cpu nodes
--------------------

Required properties:

- device_type: Must be "cpu".

- compatible: Must be "jcore,j2".

- reg: The sequential, zero-based hardware cpu number. Must be 0 on
  uniprocessor systems.

Optional properties:

- clock-frequency: Clock frequency of the cpu in Hz.


---------------------
Cache controller node
---------------------

Required properties:

- compatible: Must be "jcore,cache".

- reg: A memory range for the cache controller registers.
```

## Documentation/devicetree/bindings/power/supply/battery.txt
```
Battery Characteristics

The devicetree battery node provides static battery characteristics.
In smart batteries, these are typically stored in non-volatile memory
on a fuel gauge chip. The battery node should be used where there is
no appropriate non-volatile memory, or it is unprogrammed/incorrect.

Required Properties:
 - compatible: Must be "simple-battery"

Optional Properties:
 - voltage-min-design-microvolt: drained battery voltage
 - energy-full-design-microwatt-hours: battery design energy
 - charge-full-design-microamp-hours: battery design capacity

Batteries must be referenced by chargers and/or fuel-gauges
using a phandle. The phandle's property should be named
"monitored-battery".

Example:

	bat: battery {
		compatible = "simple-battery";
		voltage-min-design-microvolt = <3200000>;
		energy-full-design-microwatt-hours = <5290000>;
		charge-full-design-microamp-hours = <1430000>;
	};

	charger: charger@11 {
		....
		monitored-battery = <&bat>;
		...
	};

	fuel_gauge: fuel-gauge@22 {
		....
		monitored-battery = <&bat>;
		...
	};
```

## Documentation/devicetree/bindings/soc/qcom/qcom,apr.txt
```
Qualcomm APR (Asynchronous Packet Router) binding

This binding describes the Qualcomm APR. APR is a IPC protocol for
communication between Application processor and QDSP. APR is mainly
used for audio/voice services on the QDSP.

- compatible:
	Usage: required
	Value type: <stringlist>
	Definition: must be "qcom,apr-<SOC-NAME>" example: "qcom,apr-msm8996"


- qcom,smd-channel:
	Usage: required
	Value type: <string>
	Definition: standard SMD property specifying the SMD channel used for
		    communication with the APR on QDSP.
		    Should be "apr_audio_svc".
		    Described in soc/qcom/qcom,smd.txt

= EXAMPLE
The following example represents a QDSP based sound card on a MSM8996 device
which uses apr as communication between Apps and QDSP.

	apr {
		compatible = "qcom,apr-msm8996";
		qcom,smd-channels = "apr_audio_svc";
	};
```

## Documentation/devicetree/bindings/sound/qcom,apq8096.txt
```
* Qualcomm Technologies APQ8096 ASoC sound card driver

This binding describes the APQ8096 sound card, which uses qdsp for audio.

- compatible:
	Usage: required
	Value type: <stringlist>
	Definition: must be "qcom,apq8096-sndcard"

- qcom,audio-routing:
	Usage: Optional
	Value type: <stringlist>
	Definition:  A list of the connections between audio components.
		  Each entry is a pair of strings, the first being the
		  connection's sink, the second being the connection's
		  source. Valid names could be power supplies, MicBias
		  of codec and the jacks on the board:
Example:
	sound {
		compatible	= "qcom,snd-apq8096";
		qcom,model = "DB820c";
	};
```

## Documentation/devicetree/bindings/spi/jcore,spi.txt
```
J-Core SPI master

Required properties:

- compatible: Must be "jcore,spi2".

- reg: Memory region for registers.

- #address-cells: Must be 1.

- #size-cells: Must be 0.

Optional properties:

- clock-frequency: Specifies an input clock frequency relative to
  which the SPI clock speed must be programmed.

See spi-bus.txt for additional properties not specific to this device.

Example:

spi@40 {
	compatible = "jcore,spi2";
	#address-cells = <1>;
	#size-cells = <0>;
	reg = <0x40 0x8>;
	spi-max-frequency = <25000000>;
	clock-frequency = <50000000>;
}
```

## Documentation/devicetree/bindings/usb/dwc3.txt
```
synopsys DWC3 CORE

DWC3- USB3 CONTROLLER

Required properties:
 - compatible: must be "synopsys,dwc3"
 - reg : Address and length of the register set for the device
 - interrupts: Interrupts used by the dwc3 controller.
 - usb-phy : array of phandle for the PHY device

Optional properties:
 - tx-fifo-resize: determines if the FIFO *has* to be reallocated.
 - dr_mode: When set to "host", driver executes in host-only mode. If the property is
            absent or "", the controller executes in peripheral mode. Other commonly
            found values like "otg" and "peripheral" are NOT supported.
 - snps,nominal-elastic-buffer: When set, the nominal elastic buffer setting
	is used. By default, the half-full setting is used.
 - snps,ssphy-clear-auto-suspend-on-disconnect: If present, clear auto suspend feaure with ssusb phy
   during cable disconnect.
 - snps,usb3-u1u2-disable: If present, disable u1u2 low power modes for DWC3 core controller in SS mode.
 - snps,hird_thresh: If present, will determine the value of DCTL[HIRD_Thresh] which, in turn,
	controls the UTMI sleep mechanism vs. the PHY. Default value is 12.
 - snps,bus-suspend-enable: If present then controller supports low power mode
	during bus suspend.
 - snps,lpm-nyet-thresh: If present, will determine the value of DCTL[LPM_NYET_Thres].
        If BESL value received from the host in the LPM token is less than this value we send LPM ACK to the host.
        Otherwise the device returns LPM NYET.

This is usually a subnode to DWC3 glue to which it is connected.

dwc3@4a030000 {
	compatible = "synopsys,dwc3";
	reg = <0x4a030000 0xcfff>;
	interrupts = <0 92 4>;
	usb-phy = <&usb2_phy>, <&usb3,phy>;
	tx-fifo-resize;
};
```

## drivers/clk/rockchip/Kconfig
```kconfig
config COMMON_CLK_RV1108
	bool "Clock driver for Rockchip RV1108"
	depends on (ARCH_ROCKCHIP && ARM) || COMPILE_TEST
	default ARCH_ROCKCHIP && ARM

config COMMON_CLK_RK3036
	bool "Clock driver for Rockchip RK3036"
	depends on (ARCH_ROCKCHIP && ARM) || COMPILE_TEST
	default ARCH_ROCKCHIP && ARM

config COMMON_CLK_RK3188
	bool "Clock driver for Rockchip RK3066 and RK3188"
	depends on (ARCH_ROCKCHIP && ARM) || COMPILE_TEST
	default ARCH_ROCKCHIP && ARM

config COMMON_CLK_RK3228
	bool "Clock driver for Rockchip RK3228 and RK3229"
	depends on (ARCH_ROCKCHIP && ARM) || COMPILE_TEST
	default ARCH_ROCKCHIP && ARM

config COMMON_CLK_RK3288
	bool "Clock driver for Rockchip RK3288"
	depends on (ARCH_ROCKCHIP && ARM) || COMPILE_TEST
	default ARCH_ROCKCHIP && ARM

config COMMON_CLK_RK3328
	bool "Clock driver for Rockchip RK3328"
	depends on (ARCH_ROCKCHIP && ARM64) || COMPILE_TEST
	default ARCH_ROCKCHIP && ARM64

config COMMON_CLK_RK3368
	bool "Clock driver for Rockchip RK3368"
	depends on (ARCH_ROCKCHIP && ARM64) || COMPILE_TEST
	default ARCH_ROCKCHIP && ARM64

config COMMON_CLK_RK3399
	bool "Clock driver for Rockchip RK3399"
	depends on (ARCH_ROCKCHIP && ARM64) || COMPILE_TEST
	default ARCH_ROCKCHIP && ARM64
```

## drivers/infiniband/hw/mlx5/Kconfig
```kconfig
config MLX5_INFINIBAND
	tristate "Mellanox Connect-IB HCA support"
	depends on NETDEVICES && ETHERNET && PCI && MLX5_CORE
	---help---
	  This driver provides low-level InfiniBand support for
	  Mellanox Connect-IB PCI Express host channel adapters (HCAs).
	  This is required to use InfiniBand protocols such as
	  IP-over-IB or SRP with these devices.

config MLX5_INFINIBAND_VERBOSE
	bool "Enable ConnectX-4/Connect-IB verbosity"
	depends on MLX5_INFINIBAND
	---help---
	  This is a configuration option to enable verbose output to easy debug.
```
